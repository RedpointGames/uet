## UET/Lib/Container/rkm-initrd-builder/br2-external/Config.in
```kconfig
source "$BR2_EXTERNAL_REDPOINT_PATH/package/wimlib/Config.in"
source "$BR2_EXTERNAL_REDPOINT_PATH/package/wine64/Config.in"
```

## UET/Lib/Container/rkm-initrd-builder/br2-external/package/wimlib/Config.in
```kconfig
config BR2_PACKAGE_WIMLIB
	bool "wimlib"
	select BR2_PACKAGE_NTFS_3G
	select BR2_PACKAGE_LIBFUSE3
```
